## config/boards/shields/sparkle/Kconfig.defconfig
```kconfig
# Copyright (c) 2022 The ZMK Contributors
# SPDX-License-Identifier: MIT  # オープンソースのMITライセンスに基づく

if SHIELD_SPARKLE_LEFT  # ビルド時に「totem_left」シールドが選ばれている場合

config ZMK_KEYBOARD_NAME
    default "SPARKLE"  # キーボード名を"Totem"として定義（Studio表示用など）

config ZMK_SPLIT_ROLE_CENTRAL
    default y  # 左側を「中央側（ホスト）」として動作させる

endif  # if条件終了

if SHIELD_SPARKLE_LEFT || SHIELD_SPARKLE_RIGHT  # 左右どちらかのtotemシールドが選択されているとき

config ZMK_SPLIT
    default y  # この構成は分割（Split）キーボードとして動作する

endif  # if条件終了
```

## config/boards/shields/sparkle/Kconfig.shield
```kconfig
# Copyright (c) 2022 The ZMK Contributors
# SPDX-License-Identifier: MIT  # ソースコードライセンス：MIT

config SHIELD_SPARKLE_LEFT
    def_bool $(shields_list_contains,sparkle_left)  # 使用中のシールド一覧に "totem_left" が含まれていれば true

config SHIELD_SPARKLE_RIGHT
    def_bool $(shields_list_contains,sparkle_right)  # 同上、"totem_right" 用
```

## config/west.yml
```yaml
manifest:
  remotes:
    - name: zmkfirmware
      url-base: https://github.com/zmkfirmware  # リモートリポジトリのベースURL

  projects:
    - name: zmk                              # プロジェクト名
      remote: zmkfirmware                    # 使用するリモート名（上記のzmkfirmware）
      revision: main                        # ブランチやコミットを指定（ここではmainブランチ）
      import: app/west.yml                  # サブマニフェストをインポートしてさらに管理

  self:
    path: config                           # このmanifestの自身のルートパス（configディレクトリ）
```
