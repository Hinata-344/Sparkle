/*
 * Copyright (c) 2022 The ZMK Contributors
 *
 * SPDX-License-Identifier: MIT
 */

#include "totem.dtsi"  // 別ファイルに記述された行列ピン等の定義をインクルード

// キースキャン（kscan）ノードに対する列ピンの割り当て
// これはSeeeduino XIAO BLEのD4, D5, D10, D9, D8ピンを列に使用するという意味
&kscan0 {
    col-gpios = <
        &xiao_d 4 GPIO_ACTIVE_HIGH   // D4ピン：論理HIGHで有効
        &xiao_d 5 GPIO_ACTIVE_HIGH   // D5ピン
        &xiao_d 10 GPIO_ACTIVE_HIGH  // D10ピン
        &xiao_d 9 GPIO_ACTIVE_HIGH   // D9ピン
        &xiao_d 8 GPIO_ACTIVE_HIGH   // D8ピン
    >;
};
